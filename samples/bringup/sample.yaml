## samples/bringup/sample.yaml
```yaml
sample:
  description: Bring up sample application for CX1827 Board
  name: Bring Up Sample
common:
  tags: introduction
  integration_platforms:
    - nrf54h20dk@0.8.0/nrf54h20/cpuapp
tests:
  sample.bringup:
    tags: introduction
```

## west.yml
```yaml
manifest:
  remotes:
    - name: ncs
      url-base: https://github.com/nrfconnect

  defaults:
    remote: ncs

  projects:
    - name: nrf
      repo-path: sdk-nrf
      revision: v3.1.0-preview4
      path: nrf
      import: true

  self:
    path: zephyr-playground
    west-commands: scripts/west-commands.yml
    userdata:
      patches_dirs:
        - patches
```
