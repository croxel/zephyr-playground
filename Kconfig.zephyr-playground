## Kconfig.zephyr-playground
```kconfig
menu "Zephyr Playground"

rsource "subsys/Kconfig"
rsource "drivers/Kconfig"

endmenu
```

## subsys/user_alerts/Kconfig
```kconfig
config USER_ALERTS
	bool "enable user alert subsystem"
	help
	  this will enable capability to signal specific pattern on any output device
	  such as buzzer, led etc to alter user

if USER_ALERTS

config USER_ALERTS_CHANNEL_QUEUE_SIZE
	int "define maximum number of pending commands"
	default 4

endif
```

## subsys/user_button_actions/Kconfig
```kconfig
config USER_BUTTON_ACTIONS
	bool "Enable user buttin actions monitoring"
	select GPIO
	help
	  enable button monitoring to help user signal
	  multiple actions to the user

if USER_BUTTON_ACTIONS

config USER_BUTTON_ACTION_HOLD_TIMEOUT_MS
	int "timeout to detect button hold"
	default 1000

config USER_BUTTON_ACTION_RE_CLICK_TIMEOUT_MS
	int "timeout to detect button hold"
	default 250

endif
```
